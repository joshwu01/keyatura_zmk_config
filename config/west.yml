## config/west.yml
```yaml
manifest:
  remotes:
    - name: zmkfirmware
      url-base: https://github.com/zmkfirmware
    - name: ggrocer
      url-base: https://github.com/greengrocer98
  projects:
    - name: zmk
      remote: zmkfirmware
      revision: 0.3.0
      import: app/west.yml
    - name: zmk-vfx-indicator
      remote: ggrocer
      revision: main
  self:
    path: config
```
